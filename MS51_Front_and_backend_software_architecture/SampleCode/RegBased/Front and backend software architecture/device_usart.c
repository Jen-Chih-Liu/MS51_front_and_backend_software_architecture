/*
********************************************************************************
*                              实用单片机系统
*                                    MS
*
*                               主芯片:MCU51
*                           深圳市雨滴科技有限公司
*
*                                作者:王绍伟
*                                网名:凤舞天
*                                标识:Wangsw
*
*                                QQ:26033613
*                               QQ群:291235815
*                      论坛:http://gongkong.eefocus.com/bbs/
********************************************************************************
*文件名   : device_usart.c
*作用     : 串口设备
*创建时间 : 2013.8.17
********************************************************************************
*/

#include "system.h"


/*******************************************************************************
* 函数名	: putchar
* 描述	    : 被printf函数调用
* 输入参数  : c,输入字符
* 返回参数  : 返回true
********************************************************************************
*版本     作者            日期            说明
*V0.1    Wangsw        2013/09/28       初始版本
*******************************************************************************/
char putchar (char c)
{
    if (c == '\n')	            //判断换行符'\n'，若是换行符，需要插入回车符'\r'
    {
        ES = 0;                 //关闭串口中断
        SBUF = '\r';            //发送回车符
        while(!TI);	            //因为串口速度较慢，等待发送完成
        TI = 0;                 //清除发送标记
        ES = 1;                 //发送完毕，开启串口中断，以响应串口接收
    }
    
    ES = 0;                     //关闭串口中断
    SBUF = c;                   //发送printf传递过来的字符
    while(!TI);
    TI = 0;
    ES = 1;
    return(true);               //必须要返回true
}

void PutByte(byte byte)
{
    ES = 0;
    SBUF = byte;
    while(!TI);
    TI = 0;
    ES = 1;
}


/*******************************************************************************
* 函数名	: PutString
* 描述	    : 发送字节串
* 输入参数  : sum = 0,按字符串发送，sum > 0 发送sum个数据
* 返回参数  : 无
********************************************************************************
*版本     作者            日期            说明
*V0.1    Wangsw        2013/09/28       初始版本
*******************************************************************************/
void PutString(string string, byte sum) 
{
    if (sum)                        //判断是否按字符串发送
    {
        while (sum--)               //按字节流发送
            PutByte(*string++);
    } 
    else                            //按字符串发送，直到检测到0x00结束
    {
        while (*string) 
        {
            if (*string == '\n') 
                PutByte('\r');
            PutByte(*string++);
        }
    }
}

void InitUsart(void)
{
    ES = 0;

    TMOD &= 0x0F;
    TMOD |= 0x20;
    ET1 = 0;
    SetBit(PCON, 7);
    /*115200指串口速度，在22118400Hz加速模式下最高速度*/
    /*NXP和STC的都支持加速模式,式中的2就是加速模式*/
    TH1 = 0x100 - (MainClock / 12 * 2 / 32 / 115200);   
    TL1 = TH1;
    TR1 = 1;
    SCON = 0x50;

    RI = 0;
	
    ES = 1;

    /*设置中断优先级*/
    PS = 1;
    SetBit(IPH, 4);	
}

/*******************************************************************************
* 函数名	: UsartInterruptHandler
* 描述	    : 串口中断处理函数
* 输入参数  : 无     
* 返回参数  : 无
*******************************************************************************/
static void UsartHandler(void) interrupt 4
{
    RI = 0;
    
    PostMessage(MessageKey, SBUF);          // 模拟按键消息类型用于软件仿真
    //PostMessage(MessageUsart, SBUF);      // 发送串口消息
}


